## conf/layer.conf
```bitbake
# We have a conf and classes directory, add to BBPATH
BBPATH .= ":${LAYERDIR}"

# We have recipes-* directories, add to BBFILES
BBFILES += "${LAYERDIR}/recipes-*/*/*.bb \
            ${LAYERDIR}/recipes-*/*/*.bbappend"

BBFILE_COLLECTIONS += "meta-workdir-article"
BBFILE_PATTERN_meta-workdir-article = "^${LAYERDIR}/"
BBFILE_PRIORITY_meta-workdir-article = "6"

LAYERDEPENDS_meta-workdir-article = "core"
LAYERSERIES_COMPAT_meta-workdir-article = "dunfell"
```
